## main/Kconfig.projbuild
```kconfig
menu "Zigbee Blinds Controller Configuration"
    config BATTERY_MEASUREMENT_GPIO
        int "GPIO of the battery measurement"
        default 2

    config BATTERY_UPDATE_INTERVAL
        int "Battery update interval in seconds"
        default 5

    config MOTOR_FORWARD_GPIO
        int "GPIO of the motor forward"
        default 4

    config MOTOR_BACKWARD_GPIO
        int "GPIO of the motor backward"
        default 5

    config BUTTON_UP_GPIO
        int "GPIO of the button up"
        default 10

    config BUTTON_DOWN_GPIO
        int "GPIO of the button down"
        default 11
endmenu
```
